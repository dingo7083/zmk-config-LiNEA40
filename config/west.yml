## config/west.yml
```yaml
manifest:
  remotes:
    - name: zmkfirmware
      url-base: https://github.com/zmkfirmware
    - name: AntoineGS
      url-base: https://github.com/AntoineGS
    - name: keyfreaks
      url-base: https://github.com/kay-yokoyama
    - name: caksoylar
      url-base: https://github.com/caksoylar
  projects:
    - name: zmk
      remote: zmkfirmware
      revision: v0.3.0
      import: app/west.yml
    # inorichi版のフォーク(kumamuk-git経由)。ドライバ内蔵の加速を使うため乗り換え。
    # compatibleが pixart,pmw3610 → zmk,pmw3610 に変わる点だけがDT側の差分で、
    # Kconfigオプションは現行で使っている21個すべてがそのまま存在する。
    - name: zmk-pmw3610-driver
      remote: AntoineGS
      revision: 5240a7e022a3cc59036fe9c6257e0a92b796fb4e
    - name: zmk-rgbled-widget
      remote: caksoylar
      revision: v0.3-branch
  self:
    path: config
```
